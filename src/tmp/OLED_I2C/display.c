#include "display.h"

const uint8_t SmallFont[] PROGMEM = {
0x00, 0x00, 0x00, 0x00, 0x00,   // sp
0x00, 0x00, 0x2f, 0x00, 0x00,   // !
0x00, 0x07, 0x00, 0x07, 0x00,   // "
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0x00, 0x06, 0x09, 0x09, 0x06    // ~ (Degrees)
}; // 95

void displayBegin(void){
  SET_DDR_OUT(DISPLAY_DDR, SDA);
  SET_DDR_OUT(DISPLAY_DDR, SCL);
  _initTWI();
  _sendTWIcommand(SSD1306_DISPLAY_OFF);
  _sendTWIcommand(SSD1306_SET_DISPLAY_CLOCK_DIV_RATIO);
  _sendTWIcommand(0x80);
  _sendTWIcommand(SSD1306_SET_MULTIPLEX_RATIO);
  _sendTWIcommand(0x3F);
  _sendTWIcommand(SSD1306_SET_DISPLAY_OFFSET);
  _sendTWIcommand(0x0);
  _sendTWIcommand(SSD1306_SET_START_LINE | 0x0);
  _sendTWIcommand(SSD1306_CHARGE_PUMP);
  _sendTWIcommand(0x14);
  _sendTWIcommand(SSD1306_MEMORY_ADDR_MODE);
  _sendTWIcommand(0x00);
  _sendTWIcommand(SSD1306_SET_SEGMENT_REMAP | 0x1);
  _sendTWIcommand(SSD1306_COM_SCAN_DIR_DEC);
  _sendTWIcommand(SSD1306_SET_COM_PINS);
  _sendTWIcommand(0x12);
  _sendTWIcommand(SSD1306_SET_CONTRAST_CONTROL);
  _sendTWIcommand(0xCF);
  _sendTWIcommand(SSD1306_SET_PRECHARGE_PERIOD);
  _sendTWIcommand(0xF1);
  _sendTWIcommand(SSD1306_SET_VCOM_DESELECT);
  _sendTWIcommand(0x40);
  _sendTWIcommand(SSD1306_DISPLAY_ALL_ON_RESUME);
  _sendTWIcommand(SSD1306_NORMAL_DISPLAY);
  _sendTWIcommand(SSD1306_DISPLAY_ON);

  displayClean();
  displayUpdate();
}


void displayClean(void){
  for (uint16_t i=0; i<1024; i++)
    scrbuf[i] = 0;
}


void displayUpdate(void){
  //noInterrupts();
  _sendTWIcommand(SSD1306_SET_COLUMN_ADDR);
  _sendTWIcommand(0);
  _sendTWIcommand(127);

  _sendTWIcommand(SSD1306_SET_PAGE_ADDR);
  _sendTWIcommand(0);
  _sendTWIcommand(7);
  
  // Send TWI Start
  // Send start address
  TWCR = _BV(TWEN) | _BV(TWEA) | _BV(TWINT) | _BV(TWSTA);
  while ((TWCR & _BV(TWINT)) == 0) {};
  TWDR = SSD1306_ADDR<<1;
  TWCR = _BV(TWEN) | _BV(TWINT) | _BV(TWEA);
  while ((TWCR & _BV(TWINT)) == 0) {};
  TWDR = SSD1306_DATA_CONTINUE;
  TWCR = _BV(TWEN) | _BV(TWINT) | _BV(TWEA);
  while ((TWCR & _BV(TWINT)) == 0) {};

  for (int b=0; b<1024; b++){    // Send data
    TWDR = scrbuf[b];
    TWCR = _BV(TWEN) | _BV(TWINT) | _BV(TWEA);              // Clear TWINT to proceed
    while ((TWCR & _BV(TWINT)) == 0) {};                    // Wait for TWI to be ready
  }

  // Send TWI Stop
  TWCR = _BV(TWEN)| _BV(TWINT) | _BV(TWSTO);                // Send STOP
  //interrupts();
}


void _initTWI(void){
  // activate internal pullups for twi.
  SET_HIGH(DISPLAY_PORT, SDA);
  SET_HIGH(DISPLAY_PORT, SCL);

  //delay(1);  // Workaround for a linker bug

  // initialize twi prescaler and bit rate
  __cbi2(TWSR, TWPS0);
  __cbi2(TWSR, TWPS1);
  TWBR = ((F_CPU / TWI_FREQ) - 16) / 2;

  // enable twi module, acks, and twi interrupt
  TWCR = _BV(TWEN) | _BV(TWIE)/* | _BV(TWEA)*/;
}


void _sendTWIcommand(uint8_t value){
  // Send start address
  TWCR = _BV(TWEN) | _BV(TWEA) | _BV(TWINT) | _BV(TWSTA); // Send START
  while ((TWCR & _BV(TWINT)) == 0) {};                    // Wait for TWI to be ready
  TWDR = SSD1306_ADDR<<1;
  TWCR = _BV(TWEN) | _BV(TWINT) | _BV(TWEA);              // Clear TWINT to proceed
  while ((TWCR & _BV(TWINT)) == 0) {};                    // Wait for TWI to be ready

  TWDR = SSD1306_COMMAND;
  TWCR = _BV(TWEN) | _BV(TWINT) | _BV(TWEA);              // Clear TWINT to proceed
  while ((TWCR & _BV(TWINT)) == 0) {};                    // Wait for TWI to be ready
  TWDR = value;
  TWCR = _BV(TWEN) | _BV(TWINT) | _BV(TWEA);              // Clear TWINT to proceed
  while ((TWCR & _BV(TWINT)) == 0) {};                    // Wait for TWI to be ready

  TWCR = _BV(TWEN)| _BV(TWINT) | _BV(TWSTO);              // Send STOP
}

void print_char(uint8_t c, uint8_t x, uint8_t y){
  invert_text_ = 0;
  print_char_(c, x, y);
}

void print_invert_char(uint8_t c, uint8_t x, uint8_t y){
  invert_text_ = 1;
  print_char_(c, x, y);
}

void print_char_(uint8_t c, uint8_t x, uint8_t y){
  if (x > 127 || y > 63 || c < FONT_OFFSET){return;}
  uint16_t c_offset = (c - FONT_OFFSET)*FONT_WIDTH;
  for (uint8_t i=0; i<FONT_WIDTH; i++){
    if (x+i > 127){break;}
    uint8_t b = pgm_read_byte(SmallFont+c_offset+i);
    if (invert_text_){b = ~b;}
      scrbuf[(y/8)*128+x+i] = b << (y % FONT_HEIGHT);
    if (y%FONT_HEIGHT){
      // print bottom part of char
      scrbuf[(y/8+1)*128+x+i] = b >> (FONT_HEIGHT - y % FONT_HEIGHT);
    }
  }
  if (invert_text_ && x+FONT_WIDTH < 127){
    scrbuf[(y/8)*128+x+FONT_WIDTH] = 0xff << (y % FONT_HEIGHT);
    if (y%FONT_HEIGHT){
      scrbuf[(y/8+1)*128+x+FONT_WIDTH] = 0xff >> (FONT_HEIGHT - y % FONT_HEIGHT);
    }
  }
}

void print(uint8_t* str, uint8_t x, uint8_t y){
  invert_text_ = 0;
  print_string_(str, x, y);
}

void print_invert(uint8_t* str, uint8_t x, uint8_t y){
  invert_text_ = 1;
  print_string_(str, x, y);
}

void print_string_(uint8_t* str, uint8_t x, uint8_t y){
  uint8_t i=0;
  while(str[i]){
    print_char_(str[i], x+i*(FONT_WIDTH+1), y);
    i++;
  }
}
