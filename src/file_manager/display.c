#include "display.h"

const uint8_t OLED_INIT_COMMANDS[] PROGMEM = {
  0xAE, // SSD1306_DISPLAY_OFF
  0xD5, // SSD1306_SET_DISPLAY_CLOCK_DIV_RATIO
  0x80,
  0xA8, // SSD1306_SET_MULTIPLEX_RATIO
  0x3F,
  0xD3, // SSD1306_SET_DISPLAY_OFFSET
  0x00,
  SSD1306_SET_START_LINE | 0x0,
  0x8D, // SSD1306_CHARGE_PUMP
  0x14,
  0x20, // SSD1306_MEMORY_ADDR_MODE
  0x00,
  SSD1306_SET_SEGMENT_REMAP | 0x1,
  0xC8, // SSD1306_COM_SCAN_DIR_DEC
  0xDA, // SSD1306_SET_COM_PINS
  0x12,
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  0xAF, // SSD1306_DISPLAY_ON
};

const uint8_t FONT[] PROGMEM = {
  0x00, 0x00, 0x00, 0x00, 0x00,   // sp
  0x00, 0x00, 0x2f, 0x00, 0x00,   // !
  0x00, 0x07, 0x00, 0x07, 0x00,   // "
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  0x00, 0x06, 0x09, 0x09, 0x06    // ~ (Degrees)
}; // 95

void displayBegin(void){
  SET_DDR_OUT(DISPLAY_DDR, SDA);
  SET_DDR_OUT(DISPLAY_DDR, SCL);
  _initTWI();
  for (uint8_t i=0; i<sizeof(OLED_INIT_COMMANDS); i++){
    _sendTWIcommand(pgm_read_byte(OLED_INIT_COMMANDS+i));  
  }
  displayClean();
}

void displayClean(void){
  memset(&buff_, 0, sizeof(buff_));
  for (uint16_t i=0; i<8; i++){
    display_update_(i);  
  }
}

void display_update_(uint8_t y){
  //nointerrupts();
  _sendTWIcommand(0x21);
  _sendTWIcommand(0); 
  _sendTWIcommand(127);

  _sendTWIcommand(0x22); 
  _sendTWIcommand(y);
  _sendTWIcommand(7);
  
  // send twi start
  // send start address
  _send_TWI_command_start(SSD1306_DATA_CONTINUE); // 0x40
  for (uint8_t i=0; i<127; i++){
    TWDR = buff_[i];
    TWCR = _BV(TWEN) | _BV(TWINT) | _BV(TWEA);              // clear twint to proceed
    while ((TWCR & _BV(TWINT)) == 0) {};                    // wait for twi to be ready
  }
  // send twi stop
  TWCR = _BV(TWEN)| _BV(TWINT) | _BV(TWSTO);                // send stop
  //interrupts();
}

void _sendTWIcommand(uint8_t value){
  // Send start address
  _send_TWI_command_start(SSD1306_COMMAND);
  TWDR = value;
  TWCR = _BV(TWEN) | _BV(TWINT) | _BV(TWEA);              // Clear TWINT to proceed
  while ((TWCR & _BV(TWINT)) == 0) {};                    // Wait for TWI to be ready

  TWCR = _BV(TWEN)| _BV(TWINT) | _BV(TWSTO);              // Send STOP
}

void _send_TWI_command_start(uint8_t command){
  TWCR = _BV(TWEN) | _BV(TWEA) | _BV(TWINT) | _BV(TWSTA); // Send START
  while ((TWCR & _BV(TWINT)) == 0) {};                    // Wait for TWI to be ready
  TWDR = SSD1306_ADDR<<1;
  TWCR = _BV(TWEN) | _BV(TWINT) | _BV(TWEA);              // Clear TWINT to proceed
  while ((TWCR & _BV(TWINT)) == 0) {};                    // Wait for TWI to be ready

  TWDR = command;
  TWCR = _BV(TWEN) | _BV(TWINT) | _BV(TWEA);              // Clear TWINT to proceed
  while ((TWCR & _BV(TWINT)) == 0) {};                    // Wait for TWI to be ready
}

void _initTWI(void){
  // activate internal pullups for twi.
  SET_HIGH(DISPLAY_PORT, SDA);
  SET_HIGH(DISPLAY_PORT, SCL);

  //delay(1);  // Workaround for a linker bug

  // initialize twi prescaler and bit rate
  __cbi2(TWSR, TWPS0);
  __cbi2(TWSR, TWPS1);
  TWBR = ((F_CPU / TWI_FREQ) - 16) / 2;

  // enable twi module, acks, and twi interrupt
  TWCR = _BV(TWEN) | _BV(TWIE)/* | _BV(TWEA)*/;
}

void print(char* str, uint8_t x, uint8_t y){
  invert_text_ = 0;
  print_string_(str, x, y);
}

void print_invert(char* str, uint8_t x, uint8_t y){
  invert_text_ = 1;
  print_string_(str, x, y);
}

void print_string_(char* str, uint8_t x, uint8_t y){
  if (x > 127 || y > 7){return;}
  memset(&buff_, 0, sizeof(buff_));
  uint8_t i=0;
  uint8_t buff_offset;
  while(str[i]){
    buff_offset = x + i * (FONT_WIDTH + 1);
    print_char_(str[i], buff_offset);
    i++;
  }
  display_update_(y);
}

void print_char_(uint8_t c, uint8_t buff_offset){
  uint16_t char_offset = (c - FONT_OFFSET)*FONT_WIDTH;
  for (uint8_t i=0; i<FONT_WIDTH; i++){
    if (buff_offset+i >= 127){return;}
    uint8_t b = pgm_read_byte(FONT+char_offset+i);
    if (invert_text_){b = ~b;}
    buff_[buff_offset+i] = b;
  }
  if (invert_text_ && buff_offset+FONT_WIDTH <= 127){
    buff_[buff_offset+FONT_WIDTH] = 0xff;
  }
}
